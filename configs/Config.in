## configs/templates/Config.in
```kconfig
# Config.in for templates

###########################################################
#
# Template selection
#
###########################################################
choice
	prompt "Template Selection"
	default ELBOX_TEMPLATE_GW_WIFI
	help
		Select the template for the platform.

	config ELBOX_TEMPLATE_GW_WIFI
		bool "Gateway with Wifi"
		help
			A internet gateway device with Wifi.

	config ELBOX_TEMPLATE_GW_WIFI_2WAN
		bool "Gateway with Wifi and 2 WAN ports"
		help
			A internet gateway device with Wifi and 2 WAN ports.

	config ELBOX_TEMPLATE_AP_WIFI
		bool "Access Point with Wi-Fi"
		help
			An Access Point device with Wi-Fi.
        config ELBOX_TEMPLATE_AP_WIFI_CMCC
                bool "Access Point with Wi-Fi for CMCC project"
                help
                        An Access Point device with Wi-Fi for CMCC(China Mobil Communication Company).
	config ELBOX_TEMPLATE_AP_GW_WIFI
		bool "Access Point with Gateway Wi-Fi"
		help
			An Access Point and Gateway device with Wi-Fi.

	config ELBOX_TEMPLATE_AP_GAMING
		bool "Access Point for gaming"
		help
			An Access Point device for gaming.

	config ELBOX_TEMPLATE_AP_WIFI_CLOUD
		bool "Access Point with Wi-Fi for Cloud Manager"
		help
			An Access Point device with Wi-Fi for Cloud Manager.

	config ELBOX_TEMPLATE_AP_WIFI_WAN
		bool "Access Point with Wi-Fi and WAN port"
		help
			An Access Point device with Wi-Fi and WAN port.

	config ELBOX_TEMPLATE_TENDER
		bool "template for tender based project"
		help
			A router template for tender based project.

	config ELBOX_TEMPLATE_EMPTY
		bool "A empty template for what ever you want to do."

	config ELBOX_TEMPLATE_ARIES
		bool "Aries - The 1st template of project Seattle"
		help
			Aries is the first template implementation of project Seattle.
			There are several device implemented in Aries. 
	config ELBOX_TEMPLATE_ARIES_BRIDGE_AP
		bool "AriesAp - The template of project Seattle (PURE AP mode)"
		help
			ase on Seattle node formate to implement PURE AP functions.

endchoice

###########################################################
# The templates of project seattle.
config ELBOX_PROJECT_SEATTLE
	depends ELBOX_TEMPLATE_ARIES
	bool
	default y

###########################################################
source configs/templates/config.empty.in
source configs/templates/config.gw.wifi.in

source configs/templates/config.gw.wifi.2wan.in
source configs/templates/config.ap.wifi.in
source configs/templates/config.ap.wifi.wan.in
source configs/templates/config.ap.wifi.cloud.in
source configs/templates/config.ap_gw.wifi.in
source configs/templates/config.ap.gaming.in
source configs/templates/config.aries.in
source configs/templates/config.aries.ap.in
source configs/templates/config.tender.in
source configs/templates/config.ap.wifi.cmcc.in
###########################################################
comment "Features configuration"

config LOGNUM
	bool "LOGNUM - log number instead of readable string."
	default n
	help
		This option is used to replace the 'LOGNUM' declaration in the old arck.mk.
		We used to add '-DLOGNUM=1' to CFLAGS in arck.mk. This should be remove and
		all the new model should use this option to declare 'LOGNUM'. This option
		will define LOGNUM in elbox_config.h & .config files.

config ELBOX_USE_IPV6
	bool "Support IPv6"
	default n

###########################################################
#
# Language configuration
#
###########################################################
source configs/templates/config.language.in
```

## kernels/rt3883.kernel-2.6.33/arch/mips/ralink685x/Kconfig
```kconfig
if RALINK_RT6855A

choice
        prompt "Soc Hardware Type"
	default RT6855A_ASIC

config  RT6855A_FPGA 
	bool "RT6855A/RT6856A-FPGA"

config  RT6855A_ASIC 
	bool "RT6855A/RT6856A-ASIC"

endchoice

endif

config  KERNEL_NVRAM
	bool 'Kernel NVRAM' 
	default n

choice
	prompt "PCIe Setting"
	default RT6855A_PCIE_PORT0_ENABLE

config  RT6855A_PCIE_PORT0_ENABLE
        bool "Port0 ENABLE Port1 DISABLE(RT6855)"

config  RT6855A_PCIE_PORT01_ENABLE
        bool "Port0&1 ENABLE(RT6856)"
endchoice
```

## kernels/rt3883.kernel-2.6.33/arch/mips/rt2880/Kconfig
```kconfig
if RALINK_RT2880

choice
        prompt "Soc Hardware Type"
	default RT2880_ASIC

config  RT2880_FPGA 
        bool "RT2880-FPGA"
config  RT2880_ASIC 
        bool "RT2880-ASIC"
endchoice

endif
#-----------------------------

if RALINK_RT2883

choice
        prompt "Soc Hardware Type"
	default RT2883_ASIC

config  RT2883_FPGA 
        bool "RT2883-FPGA"
config  RT2883_ASIC 
        bool "RT2883-ASIC"
endchoice

endif

#---------------------------

if RALINK_RT3052

choice
        prompt "Soc Hardware Type"
	default RT3052_ASIC

config  RT3052_FPGA 
        bool "RT305x/RT3350-FPGA"
config  RT3052_ASIC 
        bool "RT305x/RT3350-ASIC"
endchoice

config RALINK_RT3350
	bool "Ralink RT3350 chipset"

config RT3x52
        bool "support RT3352 and RT3052 in the same kernel"
       depends on  !RALINK_RT3350

config RTxx50
        bool "support RT3050/RT3350 and RT5350 in the same kernel"
       depends on  !RT3x52

endif

#---------------------------

if RALINK_RT3352

choice
        prompt "Soc Hardware Type"
	default RT3352_ASIC

config  RT3352_FPGA 
	bool "RT3352-FPGA"
	select USB_ARCH_HAS_OHCI
	select USB_ARCH_HAS_EHCI

config  RT3352_ASIC 
	bool "RT3352-ASIC"
	select USB_ARCH_HAS_OHCI
	select USB_ARCH_HAS_EHCI

endchoice

config RT3x52
        bool "RT3352 and RT3052 support concurrent"

endif

#--------------------------

if RALINK_RT3883

choice
        prompt "Soc Hardware Type"
	default RT3883_FPGA

config  RT3883_FPGA 
        bool "RT3883/RT3662-FPGA"
config  RT3883_ASIC 
        bool "RT3883/RT3662-ASIC"
endchoice

choice
        prompt "RT3883 PCI architecture"
	default PCIE_PCI_CONCURRENT

config PCIE_PCI_CONCURRENT
        bool "PCIE RC and PCI HOST CONCURRENT"
config PCIE_ONLY
        bool "PCIE RC ONLY"
config PCI_ONLY
        bool "PCI HOST ONLY"
config PCIE_PCI_NONE
        bool "Non-support PCI/PCIe"
endchoice
endif
#---------------------------

if RALINK_RT5350

choice
	prompt "Soc Hardware Type"
	default RT5350_ASIC

config	RT5350_FPGA 
	bool "RT5350-FPGA"
	select USB_ARCH_HAS_OHCI
	select USB_ARCH_HAS_EHCI

config	RT5350_ASIC 
	bool "RT5350-ASIC"
	select USB_ARCH_HAS_OHCI
	select USB_ARCH_HAS_EHCI

endchoice

config RTxx50
        bool "support RT3050/RT3350 and RT5350 in the same kernel"

endif

#--------------------------

config FLASH_REMAP_NEED
       bool
       default y if (RALINK_RT2880)
choice
       prompt "DRAM Size"
       default RT2880_DRAM_16M

config RT2880_DRAM_8M
       bool "8M"

config RT2880_DRAM_16M
       bool "16M"

config RT2880_DRAM_32M
       bool "32M"

config RT2880_DRAM_64M
       bool "64M"

endchoice



choice
       prompt "Flash Size"
       default RT2880_FLASH_4M
#       depends on  FLASH_REMAP_NEED
       depends on  FLASH_REMAP_NEED || DUAL_IMAGE

config RT2880_FLASH_2M
       bool "2M"
       depends on  !DUAL_IMAGE

config RT2880_FLASH_4M
       bool "4M"

config RT2880_FLASH_8M
       bool "8M"

config RT2880_FLASH_16M
       bool "16M"

endchoice

config  DUAL_IMAGE
	bool 'Dual Image' 

#config  RT2880_FLASH_32M
#        bool "Flash Size 32MB Support"
#	depends on (RALINK_RT3052_MP2 || RALINK_RT3350) && !MTD_SPI_RALINK
#	select MTD_CONCAT if RT2880_FLASH_32M 

config  RALINK_RAM_SIZE
	int 
	default 8 if RT2880_DRAM_8M
	default 16 if RT2880_DRAM_16M
	default 32 if RT2880_DRAM_32M
	default 64 if RT2880_DRAM_64M

config MTD_PHYSMAP_START
       hex 
       default 0xBFC00000 if RT2880_FLASH_2M && !RALINK_RT3052
       default 0xBFC00000 if RT2880_FLASH_4M && !RALINK_RT3052
       default 0xBF400000 if RT2880_FLASH_8M && !RALINK_RT3052
       default 0xBEC00000 if RT2880_FLASH_16M && !RALINK_RT3052
       default 0xBF000000 if RT2880_FLASH_32M && !RALINK_RT3052
       default 0x1F000000 if !FLASH_REMAP_NEED && RT3x52
       default 0x1F000000 if !FLASH_REMAP_NEED && RTxx50
       default 0xBF000000 if !FLASH_REMAP_NEED && RALINK_RT3052
       default 0x1C000000 if !FLASH_REMAP_NEED && RALINK_RT3352
       default 0x1C000000 if !FLASH_REMAP_NEED && RALINK_RT5350
       default 0xBC000000 if !FLASH_REMAP_NEED && RALINK_RT2883
       default 0x1C000000 if !FLASH_REMAP_NEED && RALINK_RT3883

config MTD_PHYSMAP_LEN
       hex 
       default 0x200000 if RT2880_FLASH_2M
       default 0x400000 if RT2880_FLASH_4M
       default 0x800000 if RT2880_FLASH_8M
       default 0x1000000 if RT2880_FLASH_16M
       default 0x2000000 if RT2880_FLASH_32M
       default 0x1000000 if !FLASH_REMAP_NEED

config MTD_PHYSMAP_BUSWIDTH
       int 
       default 2

choice
	prompt "Root File System Type"
	default RT2880_ROOTFS_IN_RAM

config  RT2880_ROOTFS_IN_RAM
        bool "RootFS_in_RAM"
	select BLK_DEV_INITRD 
	select BLK_DEV_RAM 

config  RT2880_ROOTFS_IN_FLASH
        bool "RootFS_in_FLASH"
endchoice

config BLK_DEV_RAM_SIZE
	int 'Default RAM disk size'
	default 8192
	depends on RT2880_ROOTFS_IN_RAM

config	LZMARAMFS
	bool "Compress ramdisk by lzma instead of gzip"
	depends on RT2880_ROOTFS_IN_RAM

config ROOTFS_IN_FLASH_NO_PADDING
	bool 'No Padding between Kernel and RootFS'
	default n
	depends on RT2880_ROOTFS_IN_FLASH && !RT2880_FLASH_32M && !DUAL_IMAGE

config MTD_KERNEL_PART_SIZ
	hex 'MTD Kernel Partition Size (Unit:Bytes)'
	default 0xD0000
	depends on RT2880_ROOTFS_IN_FLASH && !ROOTFS_IN_FLASH_NO_PADDING

config  RALINK_TIMER
	tristate 'Ralink WatchDog' 

config  RALINK_TIMER_WDG
        bool "Ralink WatchDog Timer"
        depends on RALINK_TIMER

config  RALINK_TIMER_WDG_RESET_OUTPUT
        bool "Ralink WatchDog Reset Output"
        depends on RALINK_TIMER_WDG

config  RALINK_WDG_TIMER
        int "WatchDog Timer (Unit:1Sec, Max=30Sec)"
        default 10
        depends on RALINK_TIMER_WDG

config  RALINK_WDG_REFRESH_INTERVAL
        int "WatchDog Refresh Interval (Unit:1Sec, Max=30Sec)"
        default 4
        depends on RALINK_TIMER_WDG

config  RALINK_TIMER_DFS
        bool "Ralink DFS Timer"
        depends on RALINK_TIMER
```

## kernels/rt3883.kernel-2.6.33/drivers/net/raeth/Kconfig
```kconfig
config RAETH
        tristate "Ralink GMAC"
        ---help---
          This driver supports Ralink gigabit ethernet family of
          adapters.

config RTL_TAG_SUPPORT
        bool "Realtek switch proprietary tag support"
        depends on RAETH && !(RALINK_RT3052 || RALINK_RT3352)
		default n
		---help---
		  This option enable ethernet driver to inspect Realtek's switch(RTL8367R)'s proprietary tag.
	  
config RAETH_JUMBOFRAME
        bool "Jumbo Frame up to 4K bytes"
        depends on RAETH && !(RALINK_RT3052 || RALINK_RT3352)

config RAETH_CHECKSUM_OFFLOAD
        bool "TCP/UDP/IP checksum offload"
	default y
        depends on RAETH && !RALINK_RT2880

config RAETH_QOS
        bool "QoS Feature"
        depends on RAETH && !RALINK_RT2880

choice
        prompt "QoS Type"
        depends on RAETH_QOS && RAETH
        default RAETH_QOS_DSCP_BASED

config  RAETH_QOS_DSCP_BASED
        bool "DSCP-based"
        depends on RAETH_QOS && RAETH

config  RAETH_QOS_PORT_BASED
        bool "Port-based"
        depends on RAETH_QOS && RAETH

endchoice


config LAN_WAN_SUPPORT
        bool "LAN/WAN Partition"
        depends on RAETH_ROUTER || RT_3052_ESW

choice
        prompt "Board Layout Type"
        depends on LAN_WAN_SUPPORT
	default WAN_AT_P0

	config  WAN_AT_P4
	        bool "LLLL/W"
		
	config  WAN_AT_P0
	        bool "W/LLLL"
endchoice

config	ESW_DOUBLE_VLAN_TAG
	bool
	default y if RT_3052_ESW


config RAETH_GMAC2
        bool "GMAC2 Support"
        depends on RAETH && RALINK_RT3883

choice
        prompt "GMAC2 is connected to"
        depends on RAETH_GMAC2
        default MARVELL

config  GIGAPHY2
        bool "MARVELL"
        depends on RAETH_GMAC2
config  100M_PHY2
        bool "10/100M PHY (MII mode)"
        depends on RAETH_GMAC2
endchoice

config  MAC_TO_GIGAPHY_MODE_ADDR2
        hex "Phy Address"
	default 0x1E
        depends on GIGAPHY2

config  SET_ETH_NAME
        bool "enable set eth number"
		default n
config  ETH_NAME
        string "interface number start"
	default eth2
		depends on SET_ETH_NAME

config	RAETH_IGMPSNOOP
		bool "enable igmp snooping"
		default n 
```

## kernels/rt3883.kernel-2.6.33/drivers/net/raeth_sdk3510/Kconfig
```kconfig
config RAETH_SDK3510
        tristate "Ralink GMAC"
        ---help---
          This driver supports Ralink gigabit ethernet family of
          adapters.

config RAETH_SPECIAL_TAG
        bool "Ralink Special Tag (0x810x)"
        depends on RALINK_RT3052 || RALINK_RT3352 || RALINK_RT5350

config RAETH_JUMBOFRAME
        bool "Jumbo Frame up to 4K bytes"
        depends on RAETH_SDK3510 && !(RALINK_RT3052 || RALINK_RT3352 || RALINK_RT5350)

config RAETH_CHECKSUM_OFFLOAD
        bool "TCP/UDP/IP checksum offload"
	default y
        depends on RAETH_SDK3510 && !RALINK_RT2880

#config RAETH_QOS
#        bool "QoS Feature"
#        depends on RAETH && (RALINK_RT3052 || RALINK_RT3352 || RALINK_RT5350)

#choice
#        prompt "QoS Type"
#        depends on RAETH_QOS
#        default DSCP_QOS_DSCP

#config  RAETH_QOS_DSCP_BASED
#        bool "DSCP-based"
#        depends on RAETH_QOS 

#config  RAETH_QOS_PORT_BASED
#        bool "Port-based"
#        depends on RAETH_QOS

#endchoice


config	RALINK_VISTA_BASIC
	bool 'Vista Basic Logo for IC+ 175C'
        depends on LAN_WAN_SUPPORT && !RALINK_RT3052 && !RALINK_RT3352 && !RALINK_RT5350

config	ESW_DOUBLE_VLAN_TAG
	bool
	default y if RT_3052_ESW


config RAETH_GMAC2
        bool "GMAC2 Support"
        depends on RAETH_SDK3510 && RALINK_RT3883

choice
        prompt "GMAC2 is connected to"
        depends on RAETH_GMAC2
        default GE2_RGMII_AN

config  GE2_MII_FORCE_100
        bool "MII_FORCE_100 (10/100M Switch)"
        depends on !RALINK_RT3052 && !RALINK_RT3352 && !RALINK_RT5350

config  GE2_MII_AN
        bool "MII_AN (100Phy)"
        depends on !RALINK_RT3052 && !RALINK_RT3352 && !RALINK_RT5350

config  GE2_RVMII_FORCE_100
        bool "RvMII_FORCE_100 (CPU)"
        depends on !RALINK_RT3052 && !RALINK_RT3352 && !RALINK_RT5350

config  GE2_RGMII_FORCE_1000
        bool "RGMII_FORCE_1000 (GigaSW, CPU)"
        depends on !RALINK_RT3052 && !RALINK_RT3352 && !RALINK_RT5350
	select RALINK_SPI

config  GE2_RGMII_AN
        bool "RGMII_AN (GigaPhy)"
        depends on !RALINK_RT3052 && !RALINK_RT3352 && !RALINK_RT5350

endchoice

config  MAC_TO_GIGAPHY_MODE_ADDR2
        hex "Phy Address"
	default 0x1E
        depends on GE2_MII_AN || GE2_RGMII_AN 

config LAN_WAN_SUPPORT
        bool "LAN/WAN Partition"
        depends on RAETH_ROUTER || RT_3052_ESW

choice
        prompt "Switch Board Layout Type"
        depends on LAN_WAN_SUPPORT || P5_RGMII_TO_MAC_MODE ||  GE1_RGMII_FORCE_1000 || GE2_RGMII_FORCE_1000
	default WAN_AT_P0

	config  WAN_AT_P4
	        bool "LLLL/W"
		
	config  WAN_AT_P0
	        bool "W/LLLL"
endchoice
```
