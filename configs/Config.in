## kernels/rt3883.kernel-2.6.33/drivers/net/raeth_sdk4010/Kconfig
```kconfig
config RAETH_SDK4010
        tristate "Ralink GMAC"
        ---help---
          This driver supports Ralink gigabit ethernet family of
          adapters.

choice
	prompt "PDMA Version"
        depends on RAETH_SDK4010 && (RALINK_RT6352 || RALINK_RT71100)
	default PDMA_OLD

	config PDMA_OLD
	bool "OLD"

	config PDMA_NEW
	bool "NEW"

endchoice

config RAETH_SCATTER_GATHER_RX_DMA
        bool "Scatter-Gather RX DMA"
        depends on RAETH_SDK4010 && (RALINK_RT6352 || RALINK_RT71100)


config RAETH_SKB_RECYCLE
        bool "SKB Recycle(Linux)"
        depends on RAETH_SDK4010

config RAETH_SKB_RECYCLE_2K
        bool "SKB Recycle_2K(Proprietary)"
        depends on RAETH_SDK4010

config RAETH_SPECIAL_TAG
        bool "Ralink Special Tag (0x810x)"
        depends on RAETH_SDK4010 && RT_3052_ESW

config RAETH_JUMBOFRAME
        bool "Jumbo Frame up to 4K bytes"
        depends on RAETH_SDK4010 && !(RALINK_RT3052 || RALINK_RT3352 || RALINK_RT5350)

config RAETH_CHECKSUM_OFFLOAD
        bool "TCP/UDP/IP checksum offload"
	default y
        depends on RAETH_SDK4010 && !RALINK_RT2880

config RAETH_HW_VLAN_TX
        bool "Transmit VLAN HW (DoubleVLAN is not supported)"
        depends on RAETH_SDK4010 && !RALINK_RT5350
        ---help---
          Please disable HW_VLAN_TX if you need double vlan

config RAETH_TSO
        bool "TSOV4 (Tcp Segmentaton Offload)"
	depends on RAETH_HW_VLAN_TX && (RALINK_RT6855 || RALINK_RT6855A || RALINK_RT6352 || RALINK_RT71100)

config RAETH_TSOV6
        bool "TSOV6 (Tcp Segmentaton Offload)"
	depends on RAETH_HW_VLAN_TX && (RALINK_RT6855 || RALINK_RT6855A || RALINK_RT6352 || RALINK_RT71100)

#config RAETH_QOS
#        bool "QoS Feature"
#        depends on RAETH_SDK4010 && !RALINK_RT2880 && !RALINK_RT6352 && !RALINK_RT71100 && !RAETH_TSO

choice
        prompt "QoS Type"
        depends on RAETH_QOS
        default DSCP_QOS_DSCP

config  RAETH_QOS_DSCP_BASED
        bool "DSCP-based"
        depends on RAETH_QOS 

config  RAETH_QOS_VPRI_BASED
        bool "VPRI-based"
        depends on RAETH_QOS

endchoice


config LAN_WAN_SUPPORT
        bool "LAN/WAN Partition"
        default y if RAETH_ROUTER
        depends on RAETH_ROUTER || RT_3052_ESW

choice
        prompt "Switch Board Layout Type"
        depends on LAN_WAN_SUPPORT || P5_RGMII_TO_MAC_MODE ||  GE1_RGMII_FORCE_1000 || GE2_RGMII_FORCE_1000
	default WAN_AT_P0

	config  WAN_AT_P4
	        bool "LLLL/W"
		
	config  WAN_AT_P0
	        bool "W/LLLL"
endchoice

config	RALINK_VISTA_BASIC
	bool 'Vista Basic Logo for IC+ 175C'
        depends on LAN_WAN_SUPPORT && (RALINK_RT2880 || RALINK_RT3883)

config	ESW_DOUBLE_VLAN_TAG
	bool
	default y if RT_3052_ESW

config RAETH_HAS_PORT4
        bool "Port 4 Support"
        depends on RAETH_SDK4010 && (RALINK_RT6352 || RALINK_RT71100)
choice
        prompt "Target Mode"
        depends on RAETH_HAS_PORT4
	default P4_RGMII_TO_MAC_MODE

	config P4_MAC_TO_PHY_MODE
		bool "Giga_Phy (RGMII)"
	config P4_RGMII_TO_MAC_MODE
		bool "Giga_SW/iNIC (RGMII)"
	config P4_MII_TO_MAC_MODE
		bool "External_CPU (MII_RvMII)"
	config P4_RMII_TO_MAC_MODE
		bool "External_CPU (RvMII_MII)"
endchoice

config  MAC_TO_GIGAPHY_MODE_ADDR2
        hex "Port4 Phy Address"
	default 0x4
        depends on P4_MAC_TO_PHY_MODE


config RAETH_GMAC2
        bool "GMAC2 Support"
        depends on RAETH_SDK4010 && RALINK_RT3883

choice
        prompt "GMAC2 is connected to"
        depends on RAETH_GMAC2
        default GE2_RGMII_AN

config  GE2_MII_FORCE_100
        bool "MII_FORCE_100 (10/100M Switch)"
        select REATH_ROUTER
        depends on RAETH_GMAC2

config  GE2_MII_AN
        bool "MII_AN (100Phy)"
        select 100PHY
        depends on RAETH_GMAC2

config  GE2_RVMII_FORCE_100
        bool "RvMII_FORCE_100 (CPU)"
        select RAETH_ROUTER
        depends on RAETH_GMAC2

config  GE2_RGMII_FORCE_1000
        bool "RGMII_FORCE_1000 (GigaSW, CPU)"
        depends on RAETH_GMAC2
		select RALINK_SPI

config  GE2_RGMII_AN
        bool "RGMII_AN (GigaPhy)"
        select GIGAPHY
        depends on RAETH_GMAC2

endchoice

config  MAC_TO_GIGAPHY_MODE_ADDR2
        hex "GE2 Phy Address"
	default 0x1E
        depends on GE2_MII_AN || GE2_RGMII_AN


#force 100M
config RAETH_ROUTER
bool


#AN
config 100PHY
bool
```

## kernels/rt3883.kernel-2.6.33/net/bridge/Kconfig
```kconfig
#
# 802.1d Ethernet Bridging
#

config BRIDGE
	tristate "802.1d Ethernet Bridging"
	select LLC
	select STP
	---help---
	  If you say Y here, then your Linux box will be able to act as an
	  Ethernet bridge, which means that the different Ethernet segments it
	  is connected to will appear as one Ethernet to the participants.
	  Several such bridges can work together to create even larger
	  networks of Ethernets using the IEEE 802.1 spanning tree algorithm.
	  As this is a standard, Linux bridges will cooperate properly with
	  other third party bridge products.

	  In order to use the Ethernet bridge, you'll need the bridge
	  configuration tools; see <file:Documentation/networking/bridge.txt>
	  for location. Please read the Bridge mini-HOWTO for more
	  information.

	  If you enable iptables support along with the bridge support then you
	  turn your bridge into a bridging IP firewall.
	  iptables will then see the IP packets being bridged, so you need to
	  take this into account when setting up your firewall rules.
	  Enabling arptables support when bridging will let arptables see
	  bridged ARP traffic in the arptables FORWARD chain.

	  To compile this code as a module, choose M here: the module
	  will be called bridge.

	  If unsure, say N.

config BRIDGE_MULTICAST_BWCTRL
	bool "Multicast packet bandwidth control"
	depends on BRIDGE
	---help---

config BRIDGE_E_PARTITION_BWCTRL
	bool "Ethernet to Wlan Access control"
	depends on BRIDGE
	---help---

config VIRTUAL_NETDEV_TC
	bool "Virtual ethernet Device for Traffic Control"
		---help---
	Support Virtual ethernet device for traffic control.
config BRIDGE_IGMPP_PROCFS
	bool "Bridge with IGMPProxy procfs support"
	depends on BRIDGE
	---help---
	  The original kernel bridge module will flooding multicast packet to each
	  interface (port list), this kind of phenomenon will cause bandwidth of wireless
	  interface(port) has to be fouled at basic rate and make other protocols/applications
	  that use basic rate can't work fine.

	  If you say Y here,the bridge will transform multicast packet into unicast packet by
	  replace multicast MAC address with each member's MAC address.

config BRIDGE_IGMPP_PROCFS_DEBUG
	bool "Bridge with IGMPProxy procfs debugging"
	depends on BRIDGE_IGMPP_PROCFS
	---help---

config BRIDGE_ALPHA_MULTICAST_SNOOP
	bool "Bridge with Multicast snooping and wireless enhance support"
	depends on BRIDGE
	---help---
	  Deliver support for multicast table, which allow to do multicast snooping 
	  (if implemented in switch) and do wireless enhance mode.
	  Wireless enhance mode will convert multicast data packet to unicast data.
	  Note : this option can't be used together with BRIDGE_IGMPP_PROCFS, since 
	  it is intended to replace the BRIDGE_IGMPP_PROCFS in the future. 

config BRIDGE_ALPHA_MULTICAST_SNOOP_DEBUG
	bool "Bridge with Multicast snooping and wireless enhance support debugging"
    depends on BRIDGE_ALPHA_MULTICAST_SNOOP
    ---help---

config BRIDGE_PORT_GROUP
	bool "Bridge interfaces to be groups"
	depends on BRIDGE
	---help---
	  you can brideg interfaces to be groups, all eight group you can use.
	  ex. interfaces: eth0 eth1 eth2, groups[0-8]
	  	  1.bridge interfaces to be group:
		  		group0: echo "addgroup eth0 eth1" > /proc/net/bridge_group_br0 
		  		group1: echo "addgroup eth1 eth2" > /proc/net/bridge_group_br0 
		  
		  2.deny all bridge groups:
		  		echo "reset deny" > /proc/net/bridge_group_br0
		  
		  3.allow all bridge groups:
		  		echo "reset allow" > /proc/net/bridge_group_br0
				
		  4.show groups info:
		  		cat /proc/net/bridge_group_br0


		  
		  
```

## kernels/rt3883.kernel-2.6.33/ralink/Kconfig
```kconfig
menu "Ralink Module"

###########
# Debuging
###########
source "drivers/net/rt_rdm/Kconfig"

#############
# Wire
#############
#source "drivers/net/raeth/Kconfig"

if RALINK_RT3052 || RALINK_RT3352 || RALINK_RT5350
source "drivers/net/raeth_sdk3510/Kconfig"
endif

if RALINK_RT3883
source "drivers/net/raeth/Kconfig"
endif

if RALINK_RT6855A
source "drivers/net/raeth_sdk4010/Kconfig"
endif

source "ralink/Kconfig_raether_common"

#############
# Wireless
#############

config  RT2860V2_2850
        bool "Dual Band"
        depends on RALINK_RT2880

choice
        prompt "RF Type"
        depends on RALINK_RT5350 
        default RALINK_RT5350_1T1R

        config  RALINK_RT5350_1T1R
        bool "1T1R"
endchoice

choice
        prompt "RF Type"
        depends on RALINK_RT3052
        default RALINK_RT3052_2T2R

        config  RALINK_RT3050_1T1R
        bool "1T1R"

        config  RALINK_RT3051_1T2R
        bool "1T2R"

        config  RALINK_RT3052_2T2R
        bool "2T2R"
endchoice

choice
        prompt "RF Type"
        depends on  RALINK_RT3352 

        config  RALINK_RT3352_2T2R
        bool "2T2R"
endchoice

choice
	prompt "RF Type"
	depends on RALINK_RT3883

	config  RALINK_RT3662_2T2R
	bool "2T3R (RT3662)"

	config  RALINK_RT3883_3T3R
	bool "3T3R (RT3883)"
endchoice

#source "drivers/net/wireless/rt2860v2_ap/Kconfig"
#source "drivers/net/wireless/rt2860v2_sta/Kconfig"
#source "drivers/net/wireless/rt2860v2_apsta/Kconfig"
#source "drivers/net/wireless/RT3090_ap/Kconfig"
#source "drivers/net/wireless/RT3090_sta/Kconfig"
#source "drivers/net/wireless/iNIC/Kconfig"
#source "drivers/net/wireless/iNIC_RT305x/Kconfig"

#config INIC_USB
#bool
#default y if RT305x_INIC_USB

#config INIC_MII
#bool
#default y if RT2880v2_INIC_MII || RT305x_INIC_MII

#config INIC_PCI
#bool
#default y if RT2880v2_INIC_PCI

config RTDEV_PCI
bool
default y if RT3090_AP

#######
# USB
#######

config RT3XXX_EHCI_OHCI
	bool "Ralink USB EHCI/OHCI controller support"
	select USB_ARCH_HAS_OHCI
	select USB_ARCH_HAS_EHCI

#######
# NAT
#######
choice
prompt "Ralink NAT Type"
depends on RALINK_RT3052 || RALINK_RT3352 || RALINK_RT3883 || RALINK_RT6855A
	
config  RA_NAT_NONE
bool "None"

config  RA_NAT_HW
bool "Hardware"
depends on !RALINK_RT5350

endchoice

source "net/nat/hw_nat/Kconfig"

######################
# Netowrk BottomHalves
#######################

#choice
#	prompt "Ralink Network BottomHalves"	
#	default RA_NETWORK_TASKLET_BH

#config RA_NETWORK_TASKLET_BH
#bool "Tasklet"

#config RA_NETWORK_WORKQUEUE_BH
#bool "Work Queue"

#endchoice

endmenu
```
